## main/Kconfig.projbuild
```kconfig
# put here your custom config value
menu "Example Configuration"

choice ESP_RC_PROTOCOL
    prompt "RC Protocol"
    default ESP_RC_PROTOCOL_IBUS
    config ESP_RC_PROTOCOL_IBUS
        bool "I-BUS"
    config ESP_RC_PROTOCOL_PPM
        bool "PPM"
endchoice

#config ESP_WIFI_SSID
#    string "WiFi SSID"
#    default "myssid"
#    help
#	SSID (network name) for the example to connect to.

#config ESP_WIFI_PASSWORD
#    string "WiFi Password"
#    default "mypassword"
#    help
#	WiFi password (WPA or WPA2) for the example to use.

endmenu
```
